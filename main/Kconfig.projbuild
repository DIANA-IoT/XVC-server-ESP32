## main/Kconfig.projbuild
```kconfig
menu "Example Configuration"

    config STORE_HISTORY
        bool "Store command history in flash"
        default y
        help
            Linenoise line editing library provides functions to save and load
            command history. If this option is enabled, initalizes a FAT filesystem
            and uses it to store command history.
            
    choice EXAMPLE_IP_MODE
        prompt "IP Version"
        help
            Example can use either IPV4 or IPV6.

        config EXAMPLE_IPV4
            bool "IPV4"

        config EXAMPLE_IPV6
            bool "IPV6"
            select EXAMPLE_CONNECT_IPV6

    endchoice

    config EXAMPLE_PORT
        int "Port"
        range 0 65535
        default 3333
        help
            Local port the example server will listen on.
            
    choice EXAMPLE_CONNECT_INTERFACE
        prompt "Connect using"
        default EXAMPLE_CONNECT_WIFI_STATION
        help
            Protocol examples can use Wi-Fi or Ethernet to connect to the network.
            Choose which interface to use.

        config EXAMPLE_CONNECT_WIFI_STATION
            bool "Wi-Fi Station"

        config EXAMPLE_CONNECT_WIFI_AP
            bool "Wi-Fi AP"
    endchoice

    
    config EXAMPLE_WIFI_SSID
        string "WiFi SSID"
        default "myssid"
        help
            SSID (network name) for the example to connect to.

    config EXAMPLE_WIFI_PASSWORD
        string "WiFi Password"
        default "mypassword"
        help
           WiFi password (WPA or WPA2) for the example to use.
           Can be left blank if the network has no security set.
           
           
               
    config EXAMPLE_MAXIMUM_RETRY
        int "Maximum retry"
        default 5
        help
           Set the Maximum retry to avoid station reconnecting to the AP unlimited when the AP is really inexistent.
    
            
                
    config EXAMPLE_WIFI_CHANNEL
        int "WiFi Channel"
        range 1 13
        default 1
        help
            WiFi channel (network channel) for the example to use.

     config EXAMPLE_MAX_STA_CONN
        int "Maximal STA connections"
        default 4
        help
            Max number of the STA connects to AP.
    

endmenu
```
